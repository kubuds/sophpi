## ipcamera/Kconfig.rej
```kconfig
--- Kconfig
+++ Kconfig
@@ -67,6 +67,11 @@
 help
 	"enable SENSOR_GCORE_GC2053_SLAVE"
 
+config SENSOR_GCORE_GC2093
+bool "SENSOR_GCORE_GC2093"
+help
+        "enable SENSOR_GCORE_GC2093"
+
 config SENSOR_GCORE_GC2093_SLAVE
 bool "SENSOR_GCORE_GC2093_SLAVE"
 help
```

## ipcamera/configs/cv1811h_gc4653_wevb_ai_defconfig
```kconfig
CONFIG_TOOLCHAIN_MUSL_RISCV64=y
CONFIG_CROSS_COMPILE="riscv64-unknown-linux-musl-"
CONFIG_STATIC_COMPILER_SUPPORT=y
CONFIG_SUPPORT_INCLUDE_KERNEL=y
CONFIG_SUPPORT_ATOMIC=y
CONFIG_SDK_DIR=""
CONFIG_MODULE_AUDIO_MP3=n
CONFIG_MODULE_MEDIA=y
CONFIG_MODULE_MEDIA_SYS=y
CONFIG_MODULE_MEDIA_VI=y
CONFIG_MODULE_MEDIA_VPSS=y
CONFIG_MODULE_MEDIA_VENC=y
CONFIG_MODULE_MEDIA_OSD=y
CONFIG_MODULE_MEDIA_DEC=n
CONFIG_MODULE_MEDIA_AUDIO=y
CONFIG_MODULE_NETWORK=y
CONFIG_MODULE_PERIPHERAL=y
CONFIG_MODULE_ADC=y
CONFIG_MODULE_GPIO=y
CONFIG_MODULE_IRCUT=y
CONFIG_MODULE_PWM=y
CONFIG_MODULE_RTSP=y
CONFIG_MODULE_AI=y
CONFIG_MODULE_AI_MD=y
CONFIG_MODULE_AI_PD=y
CONFIG_MODULE_AI_HAND_DETECT=y
CONFIG_MODULE_AI_IRFAECE=y
CONFIG_MODULE_AI_FD_FACE=y
CONFIG_MODULE_AI_BABYCRY=y
CONFIG_MODULE_AI_CONSUMER_COUNTING=y
CONFIG_MODULE_COMMON=y
CONFIG_MODULE_PARAMPARSE=y
CONFIG_MODULE_CJSON=y
CONFIG_MODULE_MININI=y
CONFIG_MODULE_LIST=y
CONFIG_RESOURCE_INSTALL_BITMAP=y
CONFIG_RESOURCE_INSTALL_NETWORK_WWW=y
CONFIG_RESOURCE_INSTALL_FBM_CV1811H_WEVB_GC4653=y
CONFIG_SENSOR_GCORE_GC4653=y
```

## ipcamera/configs/cv186ah_gc4653_wevb_defconfig
```kconfig
CONFIG_TOOLCHAIN_GLIBC_64BIT_ARM=y
CONFIG_CROSS_COMPILE="aarch64-linux-gnu-"
CONFIG_STATIC_COMPILER_SUPPORT=y
CONFIG_SUPPORT_INCLUDE_KERNEL=y
CONFIG_SUPPORT_ATOMIC=y
CONFIG_SDK_DIR=""
CONFIG_MODULE_MEDIA_AUDIO=y
CONFIG_MODULE_MEDIA=y
CONFIG_MODULE_MEDIA_SYS=y
CONFIG_MODULE_MEDIA_VI=y
CONFIG_MODULE_MEDIA_VPSS=y
CONFIG_MODULE_MEDIA_VENC=y
CONFIG_MODULE_MEDIA_OSD=y
CONFIG_MODULE_NETWORK=y
CONFIG_MODULE_PARAMPARSE=y
CONFIG_MODULE_COMMON=y
CONFIG_MODULE_CJSON=y
CONFIG_MODULE_MININI=y
CONFIG_MODULE_LIST=y
CONFIG_MODULE_PERIPHERAL=y
CONFIG_MODULE_ADC=y
CONFIG_MODULE_GPIO=y
CONFIG_MODULE_IRCUT=y
CONFIG_MODULE_PWM=y
CONFIG_MODULE_RTSP=y
CONFIG_RESOURCE_INSTALL_BITMAP=y
CONFIG_RESOURCE_INSTALL_NETWORK_WWW=y
CONFIG_RESOURCE_INSTALL_FBM_CV186AH_WEVB_GC4653=y
CONFIG_SENSOR_GCORE_GC4653=y
CONFIG_MODULE_DISPLAY=y
CONFIG_MODULE_MEDIA_VO=y
```

## ipcamera/configs/cv186ah_gc4653_wevb_uvc_uac_defconfig
```kconfig
CONFIG_TOOLCHAIN_GLIBC_64BIT_ARM=y
CONFIG_CROSS_COMPILE="aarch64-linux-gnu-"
CONFIG_STATIC_COMPILER_SUPPORT=y
CONFIG_SUPPORT_INCLUDE_KERNEL=y
CONFIG_SUPPORT_ATOMIC=y
CONFIG_SDK_DIR=""
CONFIG_MODULE_MEDIA_AUDIO=n
CONFIG_MODULE_MEDIA=y
CONFIG_MODULE_MEDIA_SYS=y
CONFIG_MODULE_MEDIA_VI=y
CONFIG_MODULE_MEDIA_VPSS=y
CONFIG_MODULE_MEDIA_DWA=y
CONFIG_MODULE_MEDIA_VENC=y
CONFIG_MODULE_MEDIA_OSD=y
CONFIG_MODULE_MEDIA_STITCH=n
CONFIG_MODULE_CVIUAC=y
CONFIG_MODULE_CVIUVC=y
CONFIG_MODULE_NETWORK=y
CONFIG_MODULE_PARAMPARSE=y
CONFIG_MODULE_COMMON=y
CONFIG_MODULE_CJSON=y
CONFIG_MODULE_MININI=y
CONFIG_MODULE_LIST=y
CONFIG_MODULE_PERIPHERAL=y
CONFIG_MODULE_ADC=y
CONFIG_MODULE_GPIO=y
CONFIG_MODULE_IRCUT=y
CONFIG_MODULE_PWM=y
CONFIG_MODULE_RTSP=y
CONFIG_MODULE_AI=n
CONFIG_MODULE_AI_MD=n
CONFIG_MODULE_AI_PD=n
CONFIG_MODULE_AI_HAND_DETECT=n
CONFIG_MODULE_AI_IRFAECE=n
CONFIG_MODULE_AI_FD_FACE=n
CONFIG_MODULE_AI_BABYCRY=n
CONFIG_MODULE_AI_CONSUMER_COUNTING=n
CONFIG_RESOURCE_INSTALL_BITMAP=y
CONFIG_RESOURCE_INSTALL_NETWORK_WWW=y
CONFIG_RESOURCE_INSTALL_FBM_CV186AH_WEVB_GC4653=y
CONFIG_SENSOR_GCORE_GC4653=y
```

## ipcamera/configs/ipcamera_defconfig
```kconfig
CONFIG_TOOLCHAIN_MUSL_RISCV64=y
CONFIG_CROSS_COMPILE="riscv64-unknown-linux-musl-"
CONFIG_STATIC_COMPILER_SUPPORT=y
CONFIG_SUPPORT_INCLUDE_KERNEL=y
CONFIG_SUPPORT_ATOMIC=y
CONFIG_SDK_DIR=""

CONFIG_MODULE_MEDIA=y
CONFIG_MODULE_MEDIA_SYS=y
CONFIG_MODULE_MEDIA_VI=y
CONFIG_MODULE_MEDIA_VPSS=y
CONFIG_MODULE_MEDIA_VENC=y
CONFIG_MODULE_MEDIA_OSD=y
CONFIG_MODULE_MEDIA_DEC=n
CONFIG_MODULE_NETWORK=y
CONFIG_MODULE_PARAMPARSE=y
CONFIG_MODULE_COMMON=y
CONFIG_MODULE_CJSON=y
CONFIG_MODULE_MININI=y
CONFIG_MODULE_LIST=y
CONFIG_MODULE_PERIPHERAL=y
CONFIG_MODULE_ADC=y
CONFIG_MODULE_GPIO=y
CONFIG_MODULE_IRCUT=y
CONFIG_MODULE_PWM=y
CONFIG_MODULE_RTSP=y
CONFIG_RESOURCE_INSTALL_BITMAP=y
CONFIG_RESOURCE_INSTALL_NETWORK_WWW=y
CONFIG_RESOURCE_INSTALL_FBM_CV1810C_WEVB_GC4653=y
CONFIG_SENSOR_GCORE_GC2083=y
CONFIG_SENSOR_OV_OV5647=y
```
